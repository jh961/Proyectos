//LIBRERIA DTH11 SENSOR DE TEMPERATURA Y HUMEDAD--------------------------------------------------------------------------
#include "DHT.h"
DHT dht(2, DHT11);
const int ZumTemp =  4;
const int LedTemp =  11;

//libreia OLED--------------------------------------------------------------------------------------------------------------

#include <SPI.h>
#include <Wire.h>
#include <Adafruit_GFX.h>
#include <Adafruit_SSD1306.h>
#define OLED_RESET 4
Adafruit_SSD1306 display(OLED_RESET);

#define NUMFLAKES 10
#define XPOS 0
#define YPOS 1
#define DELTAY 2
#define LOGO16_GLCD_HEIGHT 16 
#define LOGO16_GLCD_WIDTH  16

//MAPA DE BITS IMAGEN SENA ---------------------------------------------------------------------------------------------------

 const unsigned char sena [] PROGMEM = {
  0x00, 0x00, 0x00, 0x00, 0x00, 0x00, 0x00, 0x07, 0xf0, 0x00, 0x00, 0x00, 0x00, 0x00, 0x00, 0x00, 
  0x00, 0x00, 0x00, 0x00, 0x00, 0x00, 0x03, 0xff, 0xff, 0xe0, 0x00, 0x00, 0x00, 0x00, 0x00, 0x00, 
  0x00, 0x00, 0x00, 0x00, 0x00, 0x00, 0x0f, 0xff, 0xff, 0xf8, 0x00, 0x00, 0x00, 0x00, 0x00, 0x00, 
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  0x00, 0x00, 0x00, 0x00, 0x00, 0x00, 0x00, 0x00, 0x00, 0x00, 0x00, 0x00, 0x00, 0x00, 0x00, 0x00
};

static const unsigned char PROGMEM logo16_glcd_bmp[] =
{ B00000000, B11000000,
  B00000001, B11000000,
  B00000001, B11000000,
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  B00000000, B00110000 };
  

#if (SSD1306_LCDHEIGHT != 32)
#error("Height incorrect, please fix Adafruit_SSD1306.h!");
#endif


void setup()

//PANTALLA OLED----------------------------------------------------------------------------------------------------------------------------------------
{  
  Serial.begin(9600);
  Serial.println("Prueba del sensor DHT11");
  dht.begin();
  pinMode(ZumTemp, OUTPUT);

  display.begin(SSD1306_SWITCHCAPVCC, 0x3C);

}

void loop(){
//SENOSR DTH11 IMPRIME EN LA PANTALLA OLED VALORES-----------------------------------------------------------------------------------------------------

display.display();
display.clearDisplay();
display.drawBitmap(0,0,sena,128,64,WHITE);
display.display();
display.clearDisplay();

{
  delay(2000);
  float h = dht.readHumidity();
  float t = dht.readTemperature();
 
  // REVISAR QUE LOS RESULTADOS SEAN VALORES NUMERICOS VALIDOS, INDICANDO QUE LA COMUNICACION ES CORRECTA
  if (isnan(h) || isnan(t)) {
    Serial.println("Falla al leer el sensor DHT11!");
    return;
  }
 
  // IMPRIMIR RESULTADO AL MONITOR SERIAL
  display.display();
  display.setTextSize(1);
  display.setTextColor(WHITE);
  display.setCursor(15,0);
  display.print("TEMPERATURA C");
  display.print(t);
  display.display();
  display.display();
display.display();
  display.setTextSize(1);
  display.setTextColor(WHITE);
  display.setCursor(20,20);
  display.print("HUMEDAD H");
  display.print(h);
  display.display();
  display.display();
  delay(2000);

if(t>32){ // si la temperatura es mayor a 22 grados celsius se activará la alarma
      digitalWrite(ZumTemp, HIGH);
      delay(700);
      digitalWrite(ZumTemp, LOW);
    }
    else{
      digitalWrite(ZumTemp, LOW);
      }
if(t>32){ // si la temperatura es mayor a 22 grados celsius se activará la alarma
      digitalWrite(LedTemp, HIGH);
      delay(700);
      digitalWrite(LedTemp, LOW);
    }
    else{
      digitalWrite(LedTemp, LOW);
      }
}
 
}
